## meta-rpi-config/conf/distro/standard.conf
```bitbake
# The long name of the distribution.
# include conf/distro/poky.conf
DISTRO = "standard"
DISTRO_NAME = "This my own Distro for experimenting purposes"

RPIC_DEFAULT_DISTRO_FEATURES = "\
	largefile \
	security \
	systemd \
	wifi \
	pam \
	pulseaudio \
	linux-firmware-rpidistro \
"

RPIC_DEFAULT_EXTRA_RDEPENDS = "\
	wlan-config\
	btop \
	nano \
	pulseaudio \
	pulseaudio-server \
	alsa-lib \
	alsa-utils \
	alsa-plugins \
"
RPIC_DEFAULT_EXTRA_RRECOMMENDS ?= "kernel-module-af-packet"


# The version of the distribution.
DISTRO_VERSION = "1.0.0"

# The version of the distribution.
DL_DIR = "${HOME}/downloads"

#The software support you want in your distribution for various features.
#You define your distribution features in the distribution configuration file.
#
#In most cases, the presence or absence of a feature in DISTRO_FEATURES is
#translated to the appropriate option supplied to the configure script during
#the do_configure task for recipes that optionally support the feature.
#For example, specifying "x11" in DISTRO_FEATURES, causes every piece of
#software built for the target that can optionally support X11 to have its X11
#support enabled.
#
#Two more examples are Bluetooth and NFS support. For a more complete list of
#features that ships with the Yocto Project and that you can provide with this
#variable, see the "Distro Features" section.
DISTRO_FEATURES = "${DISTRO_FEATURES_DEFAULT}  ${RPIC_DEFAULT_DISTRO_FEATURES}"

#Specifies a list of distro-specific packages to add to all images.
#This variable takes affect through packagegroup-base so the variable only
#really applies to the more full-featured images that include packagegroup-
#base. You can use this variable to keep distro policy out of generic images.
#As with all other distro variables, you set this variable in the distro .conf
#file.
DISTRO_EXTRA_RDEPENDS += "${RPIC_DEFAULT_EXTRA_RDEPENDS}"

#Specifies a list of distro-specific packages to add to all images if the
#packages exist. The packages might not exist or be empty (e.g. kernel
#modules). The list of packages are automatically installed but you can remove
#them.
DISTRO_EXTRA_RRECOMMENDS += "${RPIC_DEFAULT_EXTRA_RRECOMMENDS}"

#Specifies the GNU standard C library (libc) variant to use during the build
#process. This variable replaces POKYLIBC, which is no longer supported.
#
#You can select "glibc" or "musl".
TCLIBC = "glibc"
TCLIBCAPPEND = ""

LOCALCONF_VERSION = "1"
DISTRO_VERSION[vardepsexclude] = "DATE"
SDK_VERSION[vardepsexclude] = "DATE"

# SDK Config
SDK_VENDOR = "-standardsdk"
SDK_NAME = "${DISTRO}-${TCLIBC}-${SDK_ARCH}-${IMAGE_BASENAME}-${TUNE_PKGARCH}"
SDK_VERSION = "${@d.getVar('DISTRO_VERSION').replace('snapshot-${DATE}', 'snapshot')}"
SDKPATH = "/opt/${DISTRO}/${SDK_VERSION}"

# OELAYOUT_ABI allows us to notify users when the format of TMPDIR changes in
# an incompatible way. Such changes should usually be detailed in the commit
# that breaks the format and have been previously discussed on the mailing list
# with general agreement from the core team.
#
OELAYOUT_ABI = "14"

IMAGE_FSTYPES = "wic rpi-sdimg"

#
# Raspberry Pi specific
#
ENABLE_UART = "1"
LICENSE_FLAGS_ACCEPTED += " commercial synaptics-killswitch"

DISTRO_FEATURES:remove = "wayland vulkan opengl x11 pcmcia 3g bluetooth nfc pci python3 perl"

RPI_EXTRA_CONFIG = " \n \
# Enable full USB power\n \
max_usb_current=1 \n \
"

ENABLE_SPI_BUS = "0"
ENABLE_I2C = "0"
RPI_USE_U_BOOT = "0"
DISABLE_RPI_BOOT_LOGO = "1"
KERNEL_MODULE_AUTOLOAD += " snd_ua101"
GPU_MEM = "16"


#Attempts to isolate the build system from the host distribution's C library in
#order to make re-use of native shared state artifacts across different host
#distributions practical. With this class enabled, a tarball containing a
#pre-built C library is downloaded at the start of the build. In the Poky reference
#distribution this is enabled by default through
#meta/conf/distro/include/yocto-uninative.inc. Other distributions that do not
#derive from poky can also "require conf/distro/include/yocto-uninative.inc" to use this.
#Alternatively if you prefer, you can build the uninative-tarball recipe yourself, publish
#the resulting tarball (e.g. via HTTP) and set UNINATIVE_URL and UNINATIVE_CHECKSUM appropriately.
#For an example, see the meta/conf/distro/include/yocto-uninative.inc.

#The uninative class is also used unconditionally by the extensible SDK.
#When building the extensible SDK, uninative-tarball is built and the resulting
#tarball is included within the SDK.

# QA check settings - a little stricter than the OE-Core defaults
WARN_QA = "textrel files-invalid incompatible-license xorg-driver-abi \
           libdir unknown-configure-option"
ERROR_QA = "dev-so debug-deps dev-deps debug-files arch pkgconfig la \
            perms useless-rpaths rpaths staticdev ldflags pkgvarcheck \
            already-stripped compile-host-path dep-cmp \
            installed-vs-shipped  install-host-path packages-list \
            perm-config perm-line perm-link pkgv-undefined \
            pn-overrides split-strip var-undefined version-going-backwards"


require conf/distro/include/no-static-libs.inc
require conf/distro/include/yocto-uninative.inc
require conf/distro/include/security_flags.inc

INHERIT += "uninative"

BB_SIGNATURE_HANDLER ?= "OEEquivHash"
BB_HASHSERVE ??= "auto"

INIT_MANAGER = "systemd"
```

## meta-rpi-config/conf/layer.conf
```bitbake
# We have a conf and classes directory, add to BBPATH
BBPATH .= ":${LAYERDIR}"

# We have recipes-* directories, add to BBFILES
BBFILES += "${LAYERDIR}/recipes-*/*/*.bb \
            ${LAYERDIR}/recipes-*/*/*.bbappend"
BB_STRICT_CHECKSUM = "0"

BBFILE_COLLECTIONS += "meta-rpi-config"
BBFILE_PATTERN_meta-rpi-config = "^${LAYERDIR}/"
BBFILE_PRIORITY_meta-rpi-config = "6"

LAYERDEPENDS_meta-rpi-config = "core"
LAYERSERIES_COMPAT_meta-rpi-config = "langdale"

LAYERDEPENDS = " raspberrypi python security"
```
